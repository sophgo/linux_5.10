## drivers/alios_log/Kconfig
```kconfig
# SPDX-License-Identifier: GPL-2.0-only
#
# Generic alios log drivers configuration
#

menuconfig ALIOS_LOG
	bool "alios log drivers"
	default n
	help
		alios log drivers offer a generic mechanism for
		get alios log.
		Only support cv181x and cv180x currently
```

## drivers/soc/cvitek/Kconfig
```kconfig
#
# CVITEK SoC drivers
#
menu "CVITEK SoC drivers"

config CV1835_SYSDMA_REMAP
	bool "CVITEK SoC sysdma remap driver"
	depends on ARCH_CVITEK
	help
	  Enables driver for sysdma remap on CV1835 SoC.
	  If someone need to use sysDMA of CV1835, they
	  need to set src select value of related devices
	  in this top register.

config CVI_WIFI_PIN
	bool "CVITEK SoC wifi specific pin definition"
	depends on ARCH_CVITEK
	help
	  Enables driver for wifi specify pin on CviTek SoC.
	  Enable this configuration to enable API to get
	  GPIO number to do certain action, ex. power on
	  or wakeup pin.

config CVI_BT_PIN
	bool "CVITEK SoC BT specific pin definition"
	depends on ARCH_CVITEK
	help
	  Enables driver for BT specify pin on CviTek SoC.
	  Enable this configuration to enable API to get
	  GPIO number to do certain action, ex. power on
	  or wakeup pin.

config CVI_TICK_TIME
	bool "CVITEK SoC TICK TIME specific proc definition"
	depends on ARCH_CVITEK
	depends on CVITEK_FASTBOOT
	help
	  Enables proc for TICK TIME on CviTek SoC.
	  Enable this configuration to enable API to get
	  TICK TIME of SoC.

config CVITEK_FASTBOOT
	depends on ARCH_CVITEK
	bool "Support cvitek fastboot"
	help
	  This enables some features for cvitek dual_os fastboot


source "drivers/soc/cvitek/sys/Kconfig"
source "drivers/soc/cvitek/tpu/Kconfig"
source "drivers/soc/cvitek/ipcm/Kconfig"
source "drivers/soc/cvitek/clock_cooling/Kconfig"
source "drivers/soc/cvitek/ive/Kconfig"
source "drivers/soc/cvitek/fb/Kconfig"
endmenu
```

## drivers/soc/cvitek/fb/Kconfig
```kconfig
# SPDX-License-Identifier: GPL-2.0
#
# Unisys visorhba configuration
#

config CV181X_FB
    tristate "cv181x fb dirver"
    depends on ION_CVITEK
    help
        "cv181x fb"
```

## drivers/soc/cvitek/ive/Kconfig
```kconfig
# SPDX-License-Identifier: GPL-2.0
#
# Unisys visorhba configuration
#

config CV181X_IVE
	tristate "cv181x ive dirver"
	depends on ION_CVITEK && CV181X_SYS
	help
		"cv181x ive"
```
