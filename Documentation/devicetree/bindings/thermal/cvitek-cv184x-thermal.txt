## Documentation/devicetree/bindings/thermal/cvitek-cv184x-thermal.txt
```
* CVITEK CV184X Thermal Driver

** Required properties:
- compatible : "cvitek,cv184x-thermal"
- reg : Address range of the thermal registers.
- interrupts : Should contain interrupt for thermal system.
- clocks : The clocks for thermal(tempsen).
- clock-names : Should be "clk_tempsen".
- #thermal-sensor-cells : Should be <1>.
```

## arch/riscv/mach-cvitek/Kconfig
```kconfig
config ARCH_CVITEK
    bool "Cvitek SoC Family"
	select ION_CVITEK
	select SCHED_CVITEK
	help
      This enables support for Cvitek SoC family.

if ARCH_CVITEK
choice
	prompt "Select the chip of SoC"
	default ARCH_CV181X
	help
	  Select the chip for SoC

config ARCH_CV181X
	bool "Cvitek CV181X SoC"
	help
	  This enables support for Cvitek's CV181X

config ARCH_CV180X
	bool "Cvitek CV180X SoC"
	help
	  This enables support for Cvitek's CV180X

config ARCH_CV190X
        bool "Cvitek CV190X SoC"
        help
          This enables support for Cvitek's CV190X

endchoice

if ARCH_CV181X
config ARCH_CVITEK_CHIP
	string "cv181x"
	help
	  This enables support for Cvitek CV181X series

choice
	prompt "Select the platform of SoC"
	default ARCH_CV181X_FPGA
	help
	  Select the platform of SoC
	    FPGA
	    PALLADIUM
	    ASIC

config ARCH_CV181X_PALLADIUM
	bool "Cvitek CV181X SoC - Palladium"
	help
	  This enables support for Cvitek's CV181X SoC on Palladium platform

config ARCH_CV181X_FPGA
	bool "Cvitek CV181X SoC - FPGA"
	help
	  This enables support for Cvitek's CV181X SoC on FPGA platform

config ARCH_CV181X_ASIC
	bool "Cvitek CV181X SoC- ASIC"
	help
	  This enables support for Cvitek's CV181X SoC ASIC

endchoice
endif # end ARCH_CV181X

if ARCH_CV180X
config ARCH_CVITEK_CHIP
	string "cv180x"
	help
	  This enables support for Cvitek CV180X series

choice
	prompt "Select the platform of SoC"
	default ARCH_CV180X_FPGA
	help
	  Select the platform of SoC
	    FPGA
	    PALLADIUM
	    ASIC

config ARCH_CV180X_PALLADIUM
	bool "Cvitek CV180X SoC - Palladium"
	help
	  This enables support for Cvitek's CV180X SoC on Palladium platform

config ARCH_CV180X_FPGA
	bool "Cvitek CV180X SoC - FPGA"
	help
	  This enables support for Cvitek's CV180X SoC on FPGA platform

config ARCH_CV180X_ASIC
	bool "Cvitek CV180X SoC- ASIC"
	help
	  This enables support for Cvitek's CV180X SoC ASIC

endchoice
endif # end ARCH_CV180X

if ARCH_CV190X
config ARCH_CVITEK_CHIP
        string "cv190x"
        help
          This enables support for Cvitek CV190X series

choice
        prompt "Select the platform of SoC"
        default ARCH_CV190X_FPGA
        help
          Select the platform of SoC
            FPGA
            PALLADIUM
            ASIC

config ARCH_CV190X_PALLADIUM
        bool "Cvitek CV190X SoC - Palladium"
        help
          This enables support for Cvitek's CV190X SoC on Palladium platform

config ARCH_CV190X_FPGA
        bool "Cvitek CV190X SoC - FPGA"
        help
          This enables support for Cvitek's CV190X SoC on FPGA platform

config ARCH_CV190X_ASIC
        bool "Cvitek CV190X SoC- ASIC"
        help
          This enables support for Cvitek's CV190X SoC ASIC

endchoice
endif # end ARCH_CV190X


endif # end ARCH_CVITEK
```

## drivers/efuse/Kconfig
```kconfig
# SPDX-License-Identifier: GPL-2.0-only
#
# Generic efuse drivers configuration
#

menuconfig EFUSE
	bool "Efuse drivers"
	default y
	help
		Efuse drivers offer a generic mechanism for
		efuse management.
		Only support cv184x and cv181x and cv180x currently
		Efuse driver build-in is better

if EFUSE

config CV184X_EFUSE
	tristate "Efuse driver for CVITEK CV184X"
	depends on ARCH_CV184X || COMPILE_TEST
	default y
	help
		Select this driver for CVITEK CV184X efuse
		This driver is used for program and read efuse
		This driver can also be built as a module
		But build-in is better.

config CV181X_EFUSE
	tristate "Efuse driver for CVITEK CV181X"
	depends on ARCH_CV181X || COMPILE_TEST
	default y
	help
		Select this driver for CVITEK CV181X efuse
		This driver is used for program and read efuse
		This driver can also be built as a module
		But build-in is better.

config CV180X_EFUSE
	tristate "Efuse driver for CVITEK CV180X"
	depends on ARCH_CV180X || COMPILE_TEST
	default y
	help
		Select this driver for CVITEK CV180X efuse op
		This driver is used for program and read efuse
		This driver can also be built as a module
                But build-in is better.

endif
```

## drivers/input/touchscreen/focaltech/Kconfig
```kconfig
#
# Focaltech Touchscreen driver configuration
#
config TOUCHSCREEN_FTS
	tristate "Focaltech Touchscreen"
	depends on I2C
	default n
	help
	  Say Y here if you have Focaltech touch panel.
	  If unsure, say N.

	  To compile this driver as a module, choose M here: the
	  module will be called focaltech.

config TOUCHSCREEN_FTS_DIRECTORY
	string "Focaltech ts directory name"
	default "focaltech_touch"
	depends on TOUCHSCREEN_FTS

config TOUCHSCREEN_FTS_AUTO_UPGRADE
	default n
	help
	 upgrade tp firmware when power on
```

## drivers/net/can/cvitek/84X6/Kconfig
```kconfig
# SPDX-License-Identifier: GPL-2.0-only
config CAN_CVITEK_MCAN
	tristate "M_CAN integrated inside the Cvitek chip"
	help
	  Say Y here if you want support for M_CAN controller framework.
	  This is common support for devices that embed the M_CAN IP.
```

## drivers/net/can/cvitek/88a2/Kconfig
```kconfig
# SDVT-License-Identifier: GPL-2.0-only

config CAN_CVITEK_SDVT
	tristate "SDVT_CAN integrated inside the Cvitek chip"
	help
	  This driver adds SDVT IP SDVT_CAN
```

## drivers/net/can/cvitek/Kconfig
```kconfig
# SDVT-License-Identifier: GPL-2.0-only

config CAN_CVITEK
	tristate "Cvitek CAN support"
	help
	  This driver adds CVITEK support

if CAN_CVITEK
source "drivers/net/can/cvitek/88a2/Kconfig"
source "drivers/net/can/cvitek/84X6/Kconfig"
endif
```

## drivers/pinctrl/cvitek/Kconfig
```kconfig
# SPDX-License-Identifier: GPL-2.0-only

config PINCTRL_CV186X
	bool "Cvitek CV186x pinctrl driver"
	depends on ARCH_CVITEK
	default y if CHIP_CPU_CV186X
	help
	  Pinctrl driver for Cvitek CV186x (88A2) SoC.
	  Provides MMIO mapping and PM suspend/resume for pinmux registers.

config PINCTRL_CV84X6
	bool "Cvitek CV84x6 pinctrl driver"
	depends on ARCH_CVITEK
	select PINMUX
	select PINCONF
	select GENERIC_PINCONF
	default y if CHIP_CPU_CV84X6
	help
	  Full Linux pinctrl subsystem driver for the Cvitek CV84x2/CV84x6 SoC.
	  Supports pin mux selection, pull-up/down, drive strength,
	  Schmitt trigger and open-drain configuration via device tree.
	  139 pins across 6 groups (G1/G2/G3/G4/G7/G8).
```

## drivers/soc/cvitek/Kconfig.cpu
```kconfig
menu "CVITEK CPU selection"
        depends on ARCH_CVITEK

config CHIP_CPU_CV84X6
        bool "CV84X6"
	default n

config CHIP_CPU_CV186X
        bool "CV186X"
	default n

config CHIP_CPU_C906B
        bool "C906B"
	default n

config CHIP_CPU_C906L
        bool "C906L"
	default n

endmenu
```

## drivers/soc/cvitek/base/Kconfig
```kconfig
# SPDX-License-Identifier: GPL-2.0
#
# Unisys visorhba configuration
#

config CVI_BASE
	tristate "cv184x base dirver"
	depends on CVI_OSAL
	help
		"base for cv184x"
```

## drivers/soc/cvitek/clock_cooling/Kconfig
```kconfig
# SPDX-License-Identifier: GPL-2.0
#
# Unisys visorhba configuration
#

config CVI_CLK_COOLING
	tristate "cvitek clock cooling dirver"
	default m
	depends on ION_CVITEK
	help
		"cvitek clock cooling"
```

## drivers/soc/cvitek/fast_image/Kconfig
```kconfig
# SPDX-License-Identifier: GPL-2.0
#
# Unisys visorhba configuration
#

config CVI_FAST_IMAGE
	tristate "cvitek fast image dirver"
	depends on RTOS_CMDQU
	help
		"cvitek fast image"
```

## drivers/soc/cvitek/ipcm/Kconfig
```kconfig
# SPDX-License-Identifier: GPL-2.0
#
# Unisys visorhba configuration
#

config CVI_IPCM
	tristate "cv184x ipcm dirver"
	help
		"CVI_IPCM for cv184x"
```

## drivers/soc/cvitek/mon/Kconfig
```kconfig
# SPDX-License-Identifier: GPL-2.0
#
# Unisys visorhba configuration
#

config CVI_MON
	tristate "cvitek monitor dirver"
	help
		"cvitek monitor"
```

## drivers/soc/cvitek/osal/Kconfig
```kconfig
# SPDX-License-Identifier: GPL-2.0
#
# Unisys visorhba configuration
#

config CVI_OSAL
	tristate "cv184x osal dirver"
	help
		"CVI_OSAL for cv184x"
```

## drivers/soc/cvitek/rtc/Kconfig
```kconfig
# SPDX-License-Identifier: GPL-2.0
#
# Unisys visorhba configuration
#

config CVI_RTC
	tristate "cvitek rtc dirver"
	default m
	help
		"cvitek rtc"
```

## drivers/soc/cvitek/saradc/Kconfig
```kconfig
# SPDX-License-Identifier: GPL-2.0
#
# Unisys visorhba configuration
#

config CVI_SARADC
	tristate "cvitek saradc dirver"
	default m
	depends on ION_CVITEK && IIO
	help
		"sar adc"
```

## drivers/soc/cvitek/sys/Kconfig
```kconfig
# SPDX-License-Identifier: GPL-2.0
#
# Unisys visorhba configuration
#

config CVI_SYS
	tristate "cv184x sys dirver"
	depends on CVI_OSAL && CVI_BASE
	help
		"sys driver for cv184x"
```

## drivers/soc/cvitek/tde/Kconfig
```kconfig
# SPDX-License-Identifier: GPL-2.0
#
# Unisys visorhba configuration
#

config CVI_TDE
	tristate "cv184x tde dirver"
	help
		"TDE for cv184x"
```

## drivers/soc/cvitek/tpu/Kconfig
```kconfig
# SPDX-License-Identifier: GPL-2.0

config CVI_TPU
	tristate "cvitek tpu dirver"
	default m
	depends on ION_CVITEK
	help
		"cvitek tpu"
```

## drivers/soc/cvitek/trng/Kconfig
```kconfig
# SPDX-License-Identifier: GPL-2.0
#
# Unisys visorhba configuration
#

config CVI_TRNG
	tristate "cvitek trng dirver"
	help
		"cvitek trng"
```

## drivers/soc/cvitek/vendor/Kconfig
```kconfig
menu "vendor_storage options"

config CVITEK_VENDOR_STORAGE
	tristate "Cvitek vendor storage support"
	help
	  Say y here to enable cvitek vendor storage support.

config CVITEK_MMC_VENDOR_STORAGE
	tristate "Cvitek mmc vendor storage support"
	depends on CVITEK_VENDOR_STORAGE && MMC
	help
	  Say y here to enable cvitek mmc vendor storage support.

config CVITEK_FLASH_VENDOR_STORAGE
	tristate "Cvitek flash vendor storage support"
	depends on CVITEK_VENDOR_STORAGE
	help
	  Say y here to enable cvitek flash vendor storage support.

config CVITEK_MTD_VENDOR_STORAGE
	tristate "Cvitek mtd vendor storage support"
	depends on CVITEK_VENDOR_STORAGE && MTD
	help
	  Say y here to enable cvitek mtd vendor storage support.

config CVITEK_UBI_VENDOR_STORAGE
	tristate "Cvitek ubi vendor storage support"
	depends on CVITEK_VENDOR_STORAGE && MTD
	help
	  Say y here to enable cvitek mtd vendor storage support.

config CVITEK_VENDOR_STORAGE_UPDATE_LOADER
	bool "Cvitek vendor storage update loader support"
	default n
	help
	  Say y here to enable cvitek vendor storage update loader support.
	  The /dev/vendor_storage must set root user access only.

endmenu
```

## drivers/soc/cvitek/wdt/Kconfig
```kconfig
# SPDX-License-Identifier: GPL-2.0
#
# Unisys visorhba configuration
#

config CVI_WDT
	tristate "cvitek wdt dirver"
	default m
	help
		"cvitek wdt"
```
